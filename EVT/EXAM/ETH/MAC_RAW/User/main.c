/********************************** (C) COPYRIGHT *******************************
 * File Name          : main.c
 * Author             : WCH
 * Version            : V1.0.0
 * Date               : 2024/05/05
 * Description        : Main program body.
*********************************************************************************
* Copyright (c) 2021 Nanjing Qinheng Microelectronics Co., Ltd.
* Attention: This software (modified or not) and binary are used for
* microcontroller manufactured by Nanjing Qinheng Microelectronics.
*******************************************************************************/
/*
 *@Note
MAC RAW example, demonstrating that MAC RAW receives and sends data.
 */
#include "string.h"
#include "eth_driver.h"

extern volatile uint8_t LinkSta;
uint8_t MACAddr[6] = {0x84, 0xc2, 0xe4, 0x01, 0x02, 0x03};                         //MAC address
uint8_t ARPPackage[]=
{
    0xff, 0xff, 0xff, 0xff, 0xff, 0xff,     /* destination MAC address */
    0x84, 0xc2, 0x4, 0x11, 0x12, 0x13,     /* source MAC address */
    0x08,0x06,                              /* Type:ARP */
    0x00,0x01,                              /* Hardware type:Ethernet(1) */
    0x08,0x00,                              /* Protocol type:IPv4 */
    0x06,0x04,                              /* Hardware size and Protocol size*/
    0x00,0x01,                              /* Opcode:request(1) */
    0x4, 0x2, 0x4, 0x01, 0x02, 0x03,     /* Sender MAC address */
    0xc0,0xa8,0x1,0x0f,                     /* Sender IP address */
    0x00,0x00,0x00,0x00,0x00,0x00,          /* Target MAC address */
    0xc0,0xa8,0x1,0x64,                     /* Target IP address */
#if 1 /*padding 16 bytes * line numbers   */
    0x55,0x55,0x55,0x55,0x55,0x55,0x55,0x55,0x55,0x55,0x55,0x55,0x55,0x55,0x55,0x55,
    0x55,0x55,0x55,0x55,0x55,0x55,0x55,0x55,0x55,0x55,0x55,0x55,0x55,0x55,0x55,0x55,
    0x55,0x55,0x55,0x55,0x55,0x55,0x55,0x55,0x55,0x55,0x55,0x55,0x55,0x55,0x55,0x55,
#endif
#if 1
    0x55,0x55,0x55,0x55,0x55,0x55,0x55,0x55,0x55,0x55,0x55,0x55,0x55,0x55,0x55,0x55,
    0x55,0x55,0x55,0x55,0x55,0x55,0x55,0x55,0x55,0x55,0x55,0x55,0x55,0x55,0x55,0x55,
    0x55,0x55,0x55,0x55,0x55,0x55,0x55,0x55,0x55,0x55,0x55,0x55,0x55,0x55,0x55,0x55,
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    0x55,0x55,0x55,0x55,0x55,0x55,0x55,0x55,0x55,0x55,0x55,0x55,0x55,0x55,0x55,0x55
#endif
};

/*********************************************************************
 * @fn      main
 *
 * @brief   Main program
 *
 * @return  none
 */
int main(void)
{
    uint8_t i= 0;
    uint32_t PktCnt = 0;
    uint32_t ChipID;

    SystemCoreClockUpdate();
    Delay_Init();
    USART_Printf_Init(115200);                                  //USART initialize
    printf("MAC RAW Test\r\n");
    printf("SystemClk:%d\r\n", SystemCoreClock);
    GetCHIPID(&ChipID);
    printf("ChipID:%#x\r\n", ChipID);
    GetMACAddress(MACAddr);                                     //get the chip MAC address
    printf("mac addr:");
    for(i = 0; i < 6; i++)
        printf("%x ", MACAddr[i]);
    printf("\n");
    ETH_Init(MACAddr);
    /* change source MAC address */
    memcpy(&ARPPackage[6], MACAddr, 6);
    memcpy(&ARPPackage[22], MACAddr, 6);

    while(1)
    {
        WCHNET_MainTask();
        if(LinkSta)
        {
            MACRAW_Tx(ARPPackage, sizeof(ARPPackage));
            if(++PktCnt % 100 == 0)
                printf("PktCnt:%d\r\n",PktCnt);
            Delay_Ms(100);
        }
    }
}
